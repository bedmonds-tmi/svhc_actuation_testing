## AlgoTest/build/Kconfig/Kconfig.modules
```kconfig
menu "tmi_sdk (C:/Users/brandon.edmonds/dev/repos/svhc_act/deps/tmi-sdk)"
osource "C:/Users/brandon.edmonds/dev/repos/svhc_act/deps/tmi-sdk/Kconfig"
config ZEPHYR_TMI_SDK_MODULE
	bool
	default y
endmenu
menu "cmsis (C:/Users/brandon.edmonds/dev/repos/svhc_act/deps/modules/hal/cmsis)"
osource "$(ZEPHYR_CMSIS_KCONFIG)"
config ZEPHYR_CMSIS_MODULE
	bool
	default y
endmenu
menu "cmsis-dsp (C:/Users/brandon.edmonds/dev/repos/svhc_act/deps/modules/lib/cmsis-dsp)"
osource "$(ZEPHYR_CMSIS_DSP_KCONFIG)"
config ZEPHYR_CMSIS_DSP_MODULE
	bool
	default y
endmenu
menu "hal_nordic (C:/Users/brandon.edmonds/dev/repos/svhc_act/deps/modules/hal/nordic)"
osource "$(ZEPHYR_HAL_NORDIC_KCONFIG)"
config ZEPHYR_HAL_NORDIC_MODULE
	bool
	default y

config ZEPHYR_HAL_NORDIC_MODULE_BLOBS
	bool
endmenu
config ZEPHYR_MCUBOOT_MODULE
	bool
	default y
menu "segger (C:/Users/brandon.edmonds/dev/repos/svhc_act/deps/modules/debug/segger)"
osource "$(ZEPHYR_SEGGER_KCONFIG)"
config ZEPHYR_SEGGER_MODULE
	bool
	default y
endmenu
config ZEPHYR_TINYCRYPT_MODULE
	bool
	default y
menu "zcbor (C:/Users/brandon.edmonds/dev/repos/svhc_act/deps/modules/lib/zcbor)"
osource "$(ZEPHYR_ZCBOR_KCONFIG)"
config ZEPHYR_ZCBOR_MODULE
	bool
	default y
endmenu
```

## AlgoTest/build/Kconfig/Kconfig.sysbuild.modules
```kconfig
config ZEPHYR_TMI_SDK_MODULE
   bool
   default y
config ZEPHYR_CMSIS_MODULE
   bool
   default y
config ZEPHYR_CMSIS_DSP_MODULE
   bool
   default y
config ZEPHYR_HAL_NORDIC_MODULE
   bool
   default y
config ZEPHYR_MCUBOOT_MODULE
   bool
   default y
config ZEPHYR_SEGGER_MODULE
   bool
   default y
config ZEPHYR_TINYCRYPT_MODULE
   bool
   default y
config ZEPHYR_ZCBOR_MODULE
   bool
   default y
```

## AlgoTest/build/Kconfig/arch/Kconfig
```kconfig
# Load Zephyr Arch Kconfig descriptions.
osource "C:/Users/brandon.edmonds/dev/repos/svhc_act/deps/zephyr/arch/x86/Kconfig"
osource "C:/Users/brandon.edmonds/dev/repos/svhc_act/deps/zephyr/arch/xtensa/Kconfig"
osource "C:/Users/brandon.edmonds/dev/repos/svhc_act/deps/zephyr/arch/sparc/Kconfig"
osource "C:/Users/brandon.edmonds/dev/repos/svhc_act/deps/zephyr/arch/riscv/Kconfig"
osource "C:/Users/brandon.edmonds/dev/repos/svhc_act/deps/zephyr/arch/posix/Kconfig"
osource "C:/Users/brandon.edmonds/dev/repos/svhc_act/deps/zephyr/arch/nios2/Kconfig"
osource "C:/Users/brandon.edmonds/dev/repos/svhc_act/deps/zephyr/arch/mips/Kconfig"
osource "C:/Users/brandon.edmonds/dev/repos/svhc_act/deps/zephyr/arch/arm64/Kconfig"
osource "C:/Users/brandon.edmonds/dev/repos/svhc_act/deps/zephyr/arch/arm/Kconfig"
osource "C:/Users/brandon.edmonds/dev/repos/svhc_act/deps/zephyr/arch/arc/Kconfig"
```

## AlgoTest/build/Kconfig/boards/Kconfig.sysbuild
```kconfig
# Load Sysbuild board Kconfig descriptions.
osource "C:/Users/brandon.edmonds/dev/repos/svhc_act/deps/zephyr/boards/nordic/nrf52840dk/Kconfig.sysbuild"
```

## west.yml
```yaml
manifest:
  version: 0.8

  self:
    path: dev

  projects:
    - name: zephyr
      url: https://github.com/zephyrproject-rtos/zephyr
      revision: v4.1.0
      import:
        file: west.yml
        path-prefix: deps
        name-allowlist:
          - nrf
          - zephyr
          - hal_nordic
          - tinycrypt
          - segger
          - cmsis
          - mcuboot
          - zcbor
          
    - name: tmi-sdk
      url: https://github.com/bedmonds-trudell/tmi-sdk
      revision: main
      path: deps/tmi-sdk
```
