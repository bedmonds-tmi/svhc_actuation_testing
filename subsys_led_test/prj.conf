## CMakeLists.txt
```
cmake_minimum_required(VERSION 3.20.0)
find_package(Zephyr REQUIRED HINTS $ENV{ZEPHYR_BASE})

project(test)

target_sources(app PRIVATE src/main.cpp)
```

## prj.conf
```kconfig
CONFIG_LOG=y
CONFIG_TMI_SVC_LED=y
CONFIG_STD_CPP17=y
```

## rf52840dk_nrf52840.overlay
```dts
&pinctrl {
	pdm0_default_alt: pdm0_default_alt {
		group1 {
			psels = <NRF_PSEL(PDM_CLK, 0, 3)>,
				<NRF_PSEL(PDM_DIN, 0, 4)>;
		};
	};
};

dmic_dev: &pdm0 {
	status = "okay";
	pinctrl-0 = <&pdm0_default_alt>;
	pinctrl-names = "default";
	clock-source = "PCLK32M_HFXO";
	queue-size = <16>;
};
```

## src/main.cpp
```c
#include <zephyr/kernel.h>
#include <zephyr/logging/log.h>
#include <tmi/svc/led.hpp>

LOG_MODULE_REGISTER(app);

int main(void)
{
	using ledCmd = ssLed::Command::Type;
	subLed.init();
  subLed.start();
  subLed.cmd({ledCmd::SET_STATE, ssLed::State::BLINK});
  while(1) {
    k_msleep(1000);
  }
  return 0;
}
```
